## blu-generic/main/Kconfig
```kconfig
menu "BluControl Generic Configuration"
    config BLUCONTROL_BUTTONS_LENGTH
        int "Buttons length"
        default 0
        range 0 128
        help
            Number of buttons available. 0 to detect it automatically (recommended)
    
    menu "Buttons"
        #Buttons
        config BLUCONTROL_BUTTON_A_BTN
            int "Button A Button"
            default 1
            range 0 128
            help
                Button Number for the A Button. 0 if not being used

        config BLUCONTROL_BUTTON_B_BTN
            int "Button B Button"
            default 1
            range 0 128
            help
                Button Number for the B Button. 0 if not being used

        config BLUCONTROL_BUTTON_Y_BTN
            int "Button Y Button"
            default 1
            range 0 128
            help
                Button Number for the Y Button. 0 if not being used

        config BLUCONTROL_BUTTON_X_BTN
            int "Button X Button"
            default 1
            range 0 128
            help
                Button Number for the X Button. 0 if not being used

        config BLUCONTROL_BUTTON_L_BTN
            int "Button L Button"
            default 1
            range 0 128
            help
                Button Number for the L Button. 0 if not being used

        config BLUCONTROL_BUTTON_ZL_BTN
            int "Button ZL Button"
            default 1
            range 0 128
            help
                Button Number for the ZL Button. 0 if not being used

        config BLUCONTROL_BUTTON_R_BTN
            int "Button R Button"
            default 1
            range 0 128
            help
                Button Number for the R Button. 0 if not being used

        config BLUCONTROL_BUTTON_ZR_BTN
            int "Button ZR Button"
            default 1
            range 0 128
            help
                Button Number for the ZR Button. 0 if not being used

        config BLUCONTROL_BUTTON_START_BTN
            int "Button START Button"
            default 0
            range -1 128
            help
                Button Number for the START Button. 0 to use the special button for Start, -1 if not being used

        config BLUCONTROL_BUTTON_SELECT_BTN
            int "Button SELECT Button"
            default 0
            range -1 128
            help
                Button Number for the SELECT Button. 0 to use the special button for Select, -1 if not being used

        config BLUCONTROL_BUTTON_HOME_BTN
            int "Button HOME Button"
            default 0
            range -1 128
            help
                Button Number for the HOME Button. 0 to use the special button for Home, -1 if not being used

        config BLUCONTROL_BUTTON_CAPTURE_BTN
            int "Button CAPTURE Button"
            default 0
            range 0 128
            help
                Button Number for the CAPTURE Button. 0 if not being used

        config BLUCONTROL_BUTTON_STICK_L_BTN
            int "Button Stick L (L3) Button"
            default 1
            range 0 128
            help
                Button Number for the Left Stick Button. 0 if not being used

        config BLUCONTROL_BUTTON_STICK_R_BTN
            int "Button Stick R (R3) Button"
            default 1
            range 0 128
            help
                Button Number for the Right Stick Button. 0 if not being used
    endmenu

    menu "Triggers"
        config BLUCONTROL_LEFT_TRIGGER_BTN
            int "Left Trigger Button"
            default 1
            depends on BLUCONTROL_LEFT_TRIGGER_ANALOG
            range 0 128
            help
                Button Number for the left trigger when it activates. 0 if not being used
        
        config BLUCONTROL_RIGHT_TRIGGER_BTN
            int "Right Trigger Button"
            default 1
            depends on BLUCONTROL_RIGHT_TRIGGER_ANALOG
            range 0 128
            help
                Button Number for the right trigger when it activates. 0 if not being used
    endmenu
endmenu
```

## blu-generic/sdkconfig.defaults
```kconfig
#
# Bluetooth
#
CONFIG_BT_ENABLED=y
CONFIG_BT_NIMBLE_ENABLED=y
CONFIG_BT_CONTROLLER_ENABLED=y

#
# IPC (Inter-Processor Call)
#
CONFIG_ESP_IPC_TASK_STACK_SIZE=1536

#
# Kernel
#
CONFIG_FREERTOS_HZ=1000

#
# Serial flasher config
#
CONFIG_ESPTOOLPY_FLASHSIZE_4MB=y
CONFIG_ESPTOOLPY_FLASHSIZE="4MB"
CONFIG_ESPTOOLPY_HEADER_FLASHSIZE_UPDATE=y

#
# Partition Table
#
CONFIG_PARTITION_TABLE_CUSTOM=y
CONFIG_PARTITION_TABLE_CUSTOM_FILENAME="../partitions.csv"
CONFIG_PARTITION_TABLE_FILENAME="../partitions.csv"
CONFIG_PARTITION_TABLE_OFFSET=0x8000
CONFIG_PARTITION_TABLE_MD5=y
# end of Partition Table
```

## blu-ota/main/Kconfig
```kconfig
menu "BluControl OTA Configuration"
    config BLUCONTROL_OTA_LED_GPIO
        int "OTA LED mode GPIO"
        default -1
        help
            GPIO Number for the LED which will be blinking while on OTA mode. -1 for none.
endmenu
```

## blu-ota/sdkconfig.defaults
```kconfig
#
# BluControl OTA Configuration
#
CONFIG_BLUCONTROL_OTA_LED_GPIO=4
# end of BluControl OTA Configuration
# end of Component config
```

## blu-switch/main/Kconfig
```kconfig
menu "BluControl Switch Configuration"
    choice BLUCONTROL_CONTROL_TYPE
        prompt "Switch control type"
        default BLUCONTROL_CONTROL_TYPE_PRO
        help
            Select the type of controller for the Switch

        config BLUCONTROL_CONTROL_TYPE_PRO
            bool "Pro Controller"

        config BLUCONTROL_CONTROL_TYPE_N64
            bool "Nintendo 64 Controller"

        config BLUCONTROL_CONTROL_TYPE_JOY_L
            bool "Left Joycon Controller"

        config BLUCONTROL_CONTROL_TYPE_JOY_R
            bool "Right Joycon Controller"

        config BLUCONTROL_CONTROL_TYPE_SNES
            bool "SNES Controller"

        config BLUCONTROL_CONTROL_TYPE_NES
            bool "NES Controller"

        config BLUCONTROL_CONTROL_TYPE_FC
            bool "FamiCom Controller"

        config BLUCONTROL_CONTROL_TYPE_GENESIS
            bool "Genesis Controller"
    endchoice

    menu "Triggers"
        choice BLUCONTROL_LEFT_TRIGGER_BTN
            prompt "Left Trigger Button"
            default BLUCONTROL_LEFT_TRIGGER_BTN_L
            depends on BLUCONTROL_LEFT_TRIGGER_ANALOG
            help
                Select the button for the Left Trigger when it activates
    
            config BLUCONTROL_LEFT_TRIGGER_BTN_L
                bool "L Button"
    
            config BLUCONTROL_LEFT_TRIGGER_BTN_ZL
                bool "ZL Button"
        endchoice

        choice BLUCONTROL_Right_TRIGGER_BTN
            prompt "Right Trigger Button"
            default BLUCONTROL_RIGHT_TRIGGER_BTN_R
            depends on BLUCONTROL_RIGHT_TRIGGER_ANALOG
            help
                Select the button for the Right Trigger when it activates
    
            config BLUCONTROL_RIGHT_TRIGGER_BTN_R
                bool "R Button"
    
            config BLUCONTROL_RIGHT_TRIGGER_BTN_ZR
                bool "ZR Button"
        endchoice
    endmenu
endmenu
```

## blu-switch/sdkconfig.defaults
```kconfig
#
# Bluetooth
#
CONFIG_BT_ENABLED=y
CONFIG_BT_BLUEDROID_ENABLED=y
CONFIG_BT_CONTROLLER_ENABLED=y
CONFIG_BTDM_CTRL_MODE_BR_EDR_ONLY=y

#
# IPC (Inter-Processor Call)
#
CONFIG_ESP_IPC_TASK_STACK_SIZE=1536

#
# Kernel
#
CONFIG_FREERTOS_HZ=1000

#
# Serial flasher config
#
CONFIG_ESPTOOLPY_FLASHSIZE_4MB=y
CONFIG_ESPTOOLPY_FLASHSIZE="4MB"
CONFIG_ESPTOOLPY_HEADER_FLASHSIZE_UPDATE=y

#
# Partition Table
#
# CONFIG_PARTITION_TABLE_SINGLE_APP is not set
# CONFIG_PARTITION_TABLE_SINGLE_APP_LARGE is not set
# CONFIG_PARTITION_TABLE_TWO_OTA is not set
CONFIG_PARTITION_TABLE_CUSTOM=y
CONFIG_PARTITION_TABLE_CUSTOM_FILENAME="../blu-common/partitions.csv"
CONFIG_PARTITION_TABLE_FILENAME="../blu-common/partitions.csv"
CONFIG_PARTITION_TABLE_OFFSET=0x8000
CONFIG_PARTITION_TABLE_MD5=y
# end of Partition Table
```
